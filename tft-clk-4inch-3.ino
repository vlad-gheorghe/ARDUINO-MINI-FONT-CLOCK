

#include <SPI.h>
#define LCD_CS A3 // Chip Select goes to Analog 3
#define LCD_CD A2 // Command/Data goes to Analog 2
#define LCD_WR A1 // LCD Write goes to Analog 1
#define LCD_RD A6 // LCD Read goes to Analog 0
#define LCD_RESET 0 // Can alternately just connect to Arduino's reset pin

#include "Adafruit_GFX.h"    // Adafruit Grafik-Bibliothek
#include <MCUFRIEND_kbv.h>
MCUFRIEND_kbv tft;
extern uint8_t term[];
//extern const uint8_t penguin[];
#include <Wire.h>
//#include "Adafruit_BMP085.h" // Adafruit BMP085-Bibliothek

//#include "RTClib.h"

#include <DHT.h>
#define DHTPIN 13         // Zur Messung verwendeter Pin, in unserem Fall also Pin 4
#define DHTTYPE DHT11    // DHT 11

#define  BLACK   0x0000
#define BLUE    0x001F
#define RED     0xF800
#define GREEN   0x07E0
#define CYAN    0x07FF
#define MAGENTA 0xF81F
#define YELLOW  0xFFE0  
#define WHITE   0xFFFF
#define ORANGE          0xFD20
#define GREENYELLOW     0xAFE5
#define DARKGREEN       0x03E0



//RTC_DS1307 RTC; // Tiny RTC Modul

//Adafruit_BMP085 bmp;   // BMP085

DHT dht(DHTPIN, DHTTYPE);  // Initialisieren des DHTs

//DateTime now;
//DateTime time_old;
//DateTime date_old;

boolean night_mode=true;

void setup(void) {
  //Serial.begin(9600);
  // Initialisiere RTC
  Wire.begin();
 // RTC.begin();
  uint16_t g_identifier;
//  if (! RTC.isrunning()) {
    // Aktuelles Datum und Zeit setzen, falls die Uhr noch nicht läuft
   // RTC.adjust(DateTime(__DATE__, __TIME__));
 // }
  
  dht.begin();  // DHT startn
  
  uint32_t when = millis();
    
    if (!Serial) delay(5000);           //allow some time for Leonardo
    Serial.println("Serial took " + String((millis() - when)) + "ms to start");
    static uint16_t identifier;
   
    g_identifier = tft.readID(); //
    Serial.print("ID = 0x");
    Serial.println(g_identifier, HEX);
    if (g_identifier == 0x00D3 || g_identifier == 0xD3D3) g_identifier = 0x9481; // write-only shield
    if (g_identifier == 0xFFFF) g_identifier = 0x9341; // serial

    tft.begin(g_identifier);
  
   tft.setRotation(1);
   tft.setTextSize(2);
   tft.setCursor(5, 10);
  tft.setTextColor(WHITE);
   tft.println(" Indoor, time and climate monitoring");
     tft.println(" ");
       tft.println(" ");
         //tft.println(" ");
    tft.setTextColor(MAGENTA);
    tft.println(" ");
   tft.println(" 28-Iulie-2016");
   tft.println(" ");
   tft.setTextColor(YELLOW);
   tft.setTextSize(3);
   tft.println("  Adaptat de Vlad Gheorghe");
   //tft.println("     Vlad Gheorghe ");
    tft.println(" ");
    tft.setTextColor(ORANGE);
    tft.println("       inspirat de la: ");
    tft.setTextColor(WHITE); tft.setTextSize(2);
    tft.println(" ");
   tft.println("                    blog.simtronyx.de");
   
  delay(5000);
    tft.fillScreen(BLACK);
 // display_show();
 
  
}


float temp=1000;
float hum=1000;
//int32_t pressure=1000;
float min_temp=1000;
float max_temp=-1000;
float min_humidity=1000;
float max_humidity=-1000;
//int32_t min_pressure=1000000;
//int32_t max_pressure=-1000;

int tempct=0;

void loop() {

  //DateTime now=RTC.now();
  /*
  if(now.minute()!=time_old.minute()){
    show_time(time_old,true);
    time_old=now;
    show_time(time_old,false);
  }
  if(now.day()!=date_old.day()){
    show_date(date_old,true);
    date_old=now;
    show_date(date_old,false);
  }
  */
   tft.drawfloat(temp);
  float t;
  if(tempct%2==0)t=dht.readTemperature();
  //else t=bmp.readTemperature();
  if(isnan(t)){}
  else if((int)t!=(int)temp){
   show_temp(temp,true);
   temp=t;
   if(min_temp>temp)min_temp=temp;
   if(max_temp<temp)max_temp=temp;
   show_temp(temp,false);
   //delay(1000);
  }
 // tempct++;
  
  float h = dht.readHumidity();
  if(isnan(h)){}
  else if(h!=hum){
   show_hum(hum,true);
   hum=h;
   if(min_humidity>hum)min_humidity=hum;
   if(max_humidity<hum)max_humidity=hum;
   show_hum(hum,false);
   //delay(1000);
  }
  
 
}

void show_temp(float temp,boolean clear){
  
  int clearcolor=night_mode?BLACK:GREEN;
  int textcolor=night_mode?GREEN:BLACK;
  
  byte xs=20;
  byte ys=20;
  String htemp=String((int)temp);
 set_text(xs,ys,htemp,clear?clearcolor:textcolor,4);
  set_text(xs+(3*htemp.length()*8),ys,"",(clear?clearcolor:textcolor),2);
 tft.print(" "); tft.write(247); // das °-Zeichen 
  tft.setTextSize(4); 
  tft.print("C");

}

void show_hum(float hum,boolean clear){

  int clearcolor=night_mode?BLACK:DARKGREEN;
  int textcolor=night_mode?DARKGREEN:BLACK;

  byte xs=190;
  byte ys=240;
  
 set_text(40,40,String((int)hum)+" %",clear?clearcolor:GREENYELLOW,4);
 
}


String get_day_of_week(uint8_t dow){ 
  
  String dows="  ";
  switch(dow){
   case 0: dows="Duminica"; break;
   case 1: dows="Luni"; break;
   case 2: dows="Marti"; break;
   case 3: dows="Miercuri"; break;
   case 4: dows="Joi"; break;
   case 5: dows="Vineri"; break;
   case 6: dows="Simbata"; break;
  }
  
  return dows;
}
/*
void show_time(DateTime now, boolean clear){
  
  int clearcolor=night_mode?BLACK:ORANGE;
  int textcolor=night_mode?ORANGE:BLACK;

  tft.setTextColor(clear?clearcolor:textcolor);
      
  tft.setTextSize(15);
  //tft.setTextColor(YELLOW);
  tft.setCursor(10,45);
  if(now.hour()<10)tft.print("0");
  tft.print(now.hour(),DEC);
  tft.print(":");
  if(now.minute()<10)tft.print("0");
  tft.print(now.minute(),DEC);
  
}*/
/*
void show_date(DateTime now,boolean clear){
  
  int clearcolor=night_mode?BLACK:YELLOW;
  int textcolor=night_mode?YELLOW:BLACK;

  tft.setTextColor(clear?clearcolor:textcolor);
  tft.setTextSize(3);
  tft.setCursor(20,180);  
  tft.print(get_day_of_week(now.dayOfWeek()));
  tft.print(", ");
  if(now.day()<10)tft.print("0");
  tft.print(now.day(),DEC);
  tft.print(".");
  if(now.month()<10)tft.print("0");
  tft.print(now.month(),DEC);
  tft.print(".");
  tft.print(now.year(),DEC);
}
*/
void set_text(int x,int y,String text,int color,int size){
  
  tft.setTextSize(size);
  tft.setCursor(x,y);
  tft.setTextColor(color);
  tft.print(text);
}
/*
void display_show(){

  tft.fillScreen(night_mode?BLACK:WHITE); 
  set_text(45,0,">> Time & climate monitoring <<",CYAN,2);
  set_text(295,20,"* adaptat de Vlad Gheorghe *",BLUE,1);
  set_text(30,230, "Temperatura:",GREEN,1);
  set_text(375,230, "Umiditate:",GREENYELLOW,1);
   tft.drawLine(0, 220, tft.width()-1, 220, DARKGREEN); //draw line separator
  tft.drawLine(0, 32, tft.width()-1, 32, DARKGREEN); //draw line separator
   tft.drawLine(0, 162, tft.width()-1, 162, DARKGREEN); //draw line separator
  //  tft.drawBitmap(4, 12, term, 19, 40);
  //tft.write(0x00AE);
  extern const uint8_t penguin[];
         tft.setAddrWindow(300 - 40 - 40, 250 + 0, 300 - 1 - 40, 250 + 39);
        tft.pushColors(penguin, 1600, 1);
        //tft.print(brainy_bitmap);
  time_old=date_old=RTC.now();
  
  //show_time(time_old,false);
 // show_date(date_old,false);  
}*/
/*const unsigned char PROGMEM w2[]  = {
  0x00, 0x7F, 0xFF, 0xFF, 0xFF, 0xFF, 0xFF, 0xFF, 
0xFF, 0xFD, 0xA0, 0x00, 0xEF, 0xFF, 0xFF, 0xFF, 
0xFF, 0xFF, 0xFF, 0xFF, 0xFD, 0x80, 0x00, 0x1F, 
0xFF, 0xFF, 0xFF, 0xFF, 0xFF, 0xFF, 0xFF, 0xFD, 
0xE0, 0x00, 0x1F, 0xFF, 0xFF, 0xFF, 0xFF, 0xFF, 
0xFF, 0xFF, 0xF9, 0xE0, 0x00, 0x5F, 0xFF, 0xFF, 
0xFF, 0xFF, 0xFF, 0xFF, 0xFF, 0xF9, 0xE0, 0x00, 
0x2F, 0xFF, 0xFF, 0xFF, 0xFF, 0xFF, 0xFF, 0xFF, 
0xFF, 0xC0, 0x00, 0x3F, 0xFF, 0xFF, 0xFF, 0xFF, 
0x8F, 0xFF, 0xFF, 0xFB, 0xC0, 0x00, 0x7F, 0xFF, 
0xFF, 0xFF, 0xC0, 0x61, 0xFF, 0xFF, 0xFC, 0x80, 
0x00, 0x7F, 0xFF, 0xFF, 0xFF, 0xC0, 0x58, 0x01, 
0xFF, 0xFB, 0xE0, 0x00, 0x3F, 0xFF, 0xFF, 0xEF, 
0x80, 0xFC, 0xFE, 0x7F, 0xFB, 0xE0, 0x00, 0x1F, 
0xFF, 0xFF, 0xBE, 0x00, 0xFF, 0xFF, 0x2F, 0xFB, 
0xC0, 0x00, 0x1F, 0xFF, 0xFF, 0xFF, 0x00, 0xFF, 
0xFE, 0xF9, 0xFB, 0xC0, 0x00, 0x3F, 0xFF, 0xFC, 
0xFF, 0x00, 0xFF, 0xFF, 0xBF, 0x7B, 0xC0, 0x00, 
0x3F, 0xFF, 0xF3, 0xFE, 0x01, 0xFF, 0xA1, 0xB5, 
0x9B, 0xC0, 0x00, 0x1F, 0xFF, 0xC3, 0xBC, 0x00, 
0xFB, 0xC0, 0xF8, 0x2F, 0xE0, 0x00, 0x1F, 0xFF, 
0x87, 0xB8, 0x11, 0x4B, 0xE0, 0xFB, 0x37, 0xF0, 
0x00, 0x3F, 0xFF, 0x1F, 0xB8, 0x0A, 0x01, 0xE1, 
0x2B, 0xCB, 0xF8, 0x00, 0x07, 0xFE, 0x0F, 0xC8, 
0x08, 0x03, 0x80, 0x2B, 0xFD, 0xF8, 0x00, 0x1F, 
0xF8, 0x00, 0xE8, 0x00, 0xC3, 0x80, 0x3B, 0xFF, 
0xF8, 0x00, 0x3F, 0xF8, 0x00, 0x00, 0x40, 0x2D, 
0x1A, 0x3B, 0xFE, 0xF8, 0x00, 0x1F, 0xF8, 0x00, 
0x02, 0x02, 0x60, 0x80, 0x01, 0xFB, 0xD0, 0x00, 
0x1F, 0xFF, 0x00, 0x07, 0x00, 0x24, 0xD0, 0x01, 
0xFB, 0xD8, 0x00, 0x05, 0xFF, 0xF8, 0x07, 0x20, 
0x24, 0x20, 0x00, 0x3F, 0x40, 0x00, 0x01, 0xFF, 
0xFC, 0x0F, 0x00, 0x80, 0x00, 0x02, 0xDF, 0x00, 
0x00, 0x00, 0x7F, 0xFC, 0x0F, 0x04, 0x55, 0x02, 
0x30, 0xEE, 0x00, 0x00, 0x00, 0x07, 0xF8, 0x1E, 
0x00, 0xC8, 0x00, 0x72, 0x1F, 0x20, 0x00, 0x00, 
0x01, 0xD0, 0x0E, 0x01, 0x00, 0x10, 0xF0, 0x0E, 
0x00, 0x00, 0x00, 0x00, 0x90, 0x0C, 0x02, 0x40, 
0x01, 0xF0, 0x00, 0x80, 0x00, 0x00, 0x05, 0xF0, 
0x0C, 0x82, 0x20, 0x01, 0xF0, 0x00, 0x20, 0x00, 
0x00, 0x00, 0xA0, 0x04, 0x00, 0x54, 0x13, 0xF0, 
0x00, 0x00, 0x00, 0x00, 0x00, 0x80, 0x00, 0x00, 
0x30, 0x07, 0xFC, 0x00, 0x00, 0x00, 0x00, 0x00, 
0x10, 0x00, 0x86, 0x14, 0x05, 0xF8, 0x00, 0x00, 
0x00, 0x00, 0x00, 0x00, 0x08, 0x0F, 0x10, 0x09, 
0xEC, 0x00, 0x00, 0x00, 0x00, 0x00, 0x00, 0x00, 
0x1F, 0x8C, 0x01, 0xF4, 0x00, 0x00, 0x00, 0x00, 
0x00, 0x00, 0x00, 0x22, 0x4C, 0x01, 0xD4, 0x00, 
0x00, 0x00, 0x00, 0x00, 0x00, 0x00, 0x0D, 0x00, 
0x03, 0xC4, 0x00, 0x00, 0x00, 0x00, 0x00, 0x00, 
0x00, 0x01, 0x00, 0x00, 0xC0, 0x00, 0x00, 0x00, 
0x00, 0x00, 0x00, 0x00, 0x22, 0x00, 0x00, 0x44, 
0x00, 0x00, 0x00, 0x00, 0x00, 0x00, 0x00, 0x00, 
0x80, 0x01, 0xEC, 0x00, 0x00, 0x00, 0x00, 0x00, 
0x00, 0x00, 0x0C, 0x40, 0x01, 0xAC, 0x00, 0x00, 
0x00, 0x00, 0x00, 0x00, 0x00, 0x00, 0x00, 0x01, 
0x7E, 0x00, 0x00, 0x00, 0x00, 0x00, 0x00, 0x00, 
0x00, 0x00, 0x03, 0x7E, 0x00, 0x00, 0x00, 0x00, 
0x00, 0x00, 0x00, 0x00, 0x20, 0x02, 0xFB, 0x00, 
0x00, 0x00, 0x00, 0x00, 0x00, 0x00, 0x00, 0x00, 
0x01, 0xF3, 0x00, 0x00, 0x00, 0x00, 0x00, 0x00, 
0x00, 0x00, 0x02, 0x03, 0xEB, 0x80, 0x00, 0x00, 
0x00, 0x00, 0x00, 0x00, 0x10, 0x00, 0x07, 0x8B, 
0x80, 0x00, 0x00, 0x00, 0x00, 0x00, 0x00, 0x30, 
0x00, 0x1F, 0x07, 0xC0, 0x00, 0x00, 0x00, 0x00, 
0x00, 0x00, 0x30, 0x00, 0x3F, 0x27, 0xC0, 0x00, 
0x00, 0x00, 0x00, 0x00, 0x00, 0x18, 0xA0, 0x7E, 
0x3F, 0xC0, 0x00, 0x00, 0x00, 0x00, 0x00, 0x00, 
0x0F, 0x9F, 0xFC, 0x7F, 0xE0, 0x00, 0x00, 0x00, 
0x00, 0x00, 0x00, 0x9F, 0xBF, 0xF8, 0x7F, 0xA0, 
0x00, 0x00, 0x00, 0x00, 0x00, 0x00, 0x9F, 0xFF, 
0xF0, 0xFD, 0xE0, 0x00, 0x00, 0x00, 0x00, 0x00, 
0x00, 0xBF, 0xBF, 0xF7, 0xFB, 0xA0, 0x00, 0x00, 
0x00, 0x00, 0x00, 0x00, 0xBF, 0xBF, 0xE9, 0xF6, 
0x60, 0x00, 0x00, 0x00, 0x00, 0x00, 0x01, 0x1F, 
0xBF, 0xFF, 0x07, 0xD0, 0x00, 0x00, 0x00, 0x00, 
0x00, 0x01, 0x4F, 0xEF, 0xD9, 0x07, 0x90, 0x00, 
0x00, 0x00, 0x00, 0x00, 0x00, 0x67, 0xDF, 0xBF, 
0xDF, 0x90, 0x00, 0x00, 0x00, 0x00, 0x00, 0x03, 
0xEF, 0xDF, 0x7F, 0xFF, 0x00, 0x00, 0x00, 0x00, 
0x00, 0x00, 0x03, 0xF7, 0xDF, 0x7F, 0xFF, 0x20, 
0x00, 0x00, 0x00, 0x00, 0x00, 0x07, 0xF3, 0xFE, 
0xFF, 0xFE, 0x20, 0x00, 0x00, 0x00, 0x00, 0x00, 
0x07, 0xF3, 0xFE, 0xFF, 0xFC, 0x60, 0x00, 0x00, 
0x00, 0x00, 0x00, 0x03, 0xF3, 0xFE, 0xFF, 0xFD, 
0xA0, 0x00, 0x00, 0x00, 0x00, 0x00, 0x03, 0xFB, 
0xFE, 0xFF, 0xFF, 0xF0, 0x00, 0x00, 0x00, 0x00, 
0x00, 0x03, 0xFF, 0xFF, 0xFF, 0xFF, 0xE0, 0x00, 
0x00, 0x00, 0x00, 0x00, 0x00, 0x00, 0x00, 0x00, 
0x00, 0x00, 0x00, 0x00, 0x00, 0x00, 0x00, 0x00, 
0x00, 0x00, 0x00, 0x00, 0x00, 0x00};

*/
